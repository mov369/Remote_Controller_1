#include <SPI.h>
#include "lookup.c"   //lookup tables for mappings
#include <mcp_can.h>

#define CAN_500KBPS 16     // CAN baud rate
#define SPI_CS_PIN  17     // setup chip select pin for CAN module
#define LED 23              //LED pin to show program active
#define STEERADC A2       // ADC for steer pot
#define THROADC A0        // ADC for Throttle pot
#define SW1 12            // SW1 input
#define SW2 6             // SW2 input
#define HEADLIGHTS 5      // Headlights input
#define CH3ADC A1         /// Horn signal 
#define INDICATOR_L 4     // Left indicator
#define INDICATOR_R 21    // Right indicator

#define PROGRAM_MODE true     // set this to enable the serial port (the code will not run if serial enabled but not connected)



MCP_CAN CAN(SPI_CS_PIN);            // Set CS pin

void setup()
{
  
  pinMode(LED, OUTPUT);     // Set pins as digital inputs and outputs
  pinMode(SW1, INPUT);
  pinMode(SW2, INPUT);
  pinMode(HEADLIGHTS, INPUT);
  pinMode(INDICATOR_L, INPUT_PULLUP);  //Indicators switch to ground so need a pullup
  pinMode(INDICATOR_R, INPUT_PULLUP);

  if (PROGRAM_MODE == true){
     Serial.begin(115200);
     while(!Serial);
  }
    while (CAN_OK != CAN.begin(CAN_500KBPS))    // init can bus : baudrate = 500k
    {
      if (PROGRAM_MODE == true){
       Serial.println("CAN BUS FAIL!");
      delay(100);
      }
    }
   if (PROGRAM_MODE == true){
      Serial.println("CAN BUS OK!");
   } 
}
int SteerRawValue = 0;  // raw value of steer pot
int ThroRawValue = 0;   // raw value of throttle pot

const unsigned int Steer_X[5] = {0x00, 0x1A0, 0x1EA, 0x220, 0x393};    //Arduino has 10 bit ADC so 0->2FF
const int  Steer_Y[5] =         {-100,   0,      0,      0,      100};

const unsigned int Torque_X[5] = {0xE1, 0x1A0, 0x1E5, 0x200, 0x3A5};
const int  Torque_Y[5] =        {-100,   0,      0,      0,      100};

const unsigned long frameRepetitionTime=5;  // repetition rate of the frame in ms  SET TO 1s for INITIAL TESTS
unsigned long previousTime;                    // last time for frame rate calcs

byte CustomerControl1[8];
byte CustomerControl2[8];
byte count = 0;  // rolling counter for alive signal
byte test[8]={0,0,0,0,1,1,1,1};
bool leds = true;
int timer=0;


void loop()
{
unsigned long currentTime = millis();   // grab the current time
unsigned int CH3Input = 0;


if (currentTime-previousTime >= frameRepetitionTime) {

  SteerRawValue = analogRead(STEERADC);// read the value from the analog steer  channel
  ThroRawValue = analogRead(THROADC);   // read the value from the analog throttle channel
  CH3Input=analogRead(CH3ADC);          // read the value from Ch3 (strange oscillating small signal)
  CustomerControl1[1] = count++;
  CustomerControl1[2]= (byte)lookup_u16_s16(SteerRawValue, Steer_X, Steer_Y, 5);   // convert to a byte +_100% 
  CustomerControl1[3]= (byte)lookup_u16_s16(ThroRawValue, Torque_X, Torque_Y, 5);

digitalWrite(LED,leds);
leds=!leds;
  CustomerControl1[4] = 0;
  CustomerControl1[5] = 0;  
  CustomerControl1[6] = 0;
  CustomerControl1[7] = 0;  
	if(digitalRead(SW1) == false) { CustomerControl1[7] += 0x10; }
  if(digitalRead(SW2) == false) { CustomerControl1[7] += 0x01; }
      
  CustomerControl1[0] = Compute_CRC8(CustomerControl1);

  CAN.sendMsgBuf(0x101, 0, 8, CustomerControl1 );     // send the CAN message

  if (timer<255) { Serial.println(CustomerControl1[1]);Serial.println(CustomerControl1[0]);}
 timer++;
  CustomerControl2[0]=0;
  CustomerControl2[1]=0;
  CustomerControl2[2]=0;
  CustomerControl2[3]=0;
  CustomerControl2[4]=0;
  CustomerControl2[5]=0;
  CustomerControl2[6]=0;
  CustomerControl2[7]=0;

  if (CH3Input>100) {  //if horn button pressed
    // switch on
    CustomerControl2[5] = CustomerControl2[5] | B10000000;
  } 
 	if(digitalRead(HEADLIGHTS) == true) { CustomerControl2[5] = CustomerControl2[5] | B00000010;}
	if(digitalRead(INDICATOR_L) == false) { CustomerControl2[5] = CustomerControl2[5] | B00010000;}
  if(digitalRead(INDICATOR_R) == false) {CustomerControl2[5] = CustomerControl2[5] | B00001000; }

 CAN.sendMsgBuf(0x104, 0, 8, CustomerControl2 );

  previousTime = currentTime;   // set previous time for next timer loop
  }  // if currentTime-previousTime
}  // loop

// Now deal with CRC calculation
  const unsigned int crc8_data[256] =
{
	0x00,0x1d,0x3a,0x27,0x74,0x69,0x4e,0x53,0xe8,0xf5,0xd2,0xcf,0x9c,0x81,0xa6,0xbb,
	0xcd,0xd0,0xf7,0xea,0xb9,0xa4,0x83,0x9e,0x25,0x38,0x1f,0x02,0x51,0x4c,0x6b,0x76,
	0x87,0x9a,0xbd,0xa0,0xf3,0xee,0xc9,0xd4,0x6f,0x72,0x55,0x48,0x1b,0x06,0x21,0x3c,
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	0x7f,0x62,0x45,0x58,0x0b,0x16,0x31,0x2c,0x97,0x8a,0xad,0xb0,0xe3,0xfe,0xd9,0xc4 };
 /* 0x00 0x07 0x0E 0x09 0x1C 0x1B 0x12 0x15 0x38 0x3F 0x36 0x31 0x24 0x23 0x2A 0x2D
0x70, 0x77, 0x7E, 0x79, 0x6C, 0x6B, 0x62, 0x65, 0x48, 0x4F, 0x46, 0x41, 0x54, 0x53, 0x5A, 0x5D,
0xE0, 0xE7, 0xEE, 0xE9, 0xFC, 0xFB, 0xF2, 0xF5, 0xD8, 0xDF, 0xD6, 0xD1, 0xC4, 0xC3, 0xCA, 0xCD,
0x90 0x97 0x9E 0x99 0x8C 0x8B 0x82 0x85 0xA8 0xAF 0xA6 0xA1 0xB4 0xB3 0xBA 0xBD
0xC7 0xC0 0xC9 0xCE 0xDB 0xDC 0xD5 0xD2 0xFF 0xF8 0xF1 0xF6 0xE3 0xE4 0xED 0xEA
0xB7 0xB0 0xB9 0xBE 0xAB 0xAC 0xA5 0xA2 0x8F 0x88 0x81 0x86 0x93 0x94 0x9D 0x9A
0x27 0x20 0x29 0x2E 0x3B 0x3C 0x35 0x32 0x1F 0x18 0x11 0x16 0x03 0x04 0x0D 0x0A
0x57 0x50 0x59 0x5E 0x4B 0x4C 0x45 0x42 0x6F 0x68 0x61 0x66 0x73 0x74 0x7D 0x7A
0x89 0x8E 0x87 0x80 0x95 0x92 0x9B 0x9C 0xB1 0xB6 0xBF 0xB8 0xAD 0xAA 0xA3 0xA4
0xF9 0xFE 0xF7 0xF0 0xE5 0xE2 0xEB 0xEC 0xC1 0xC6 0xCF 0xC8 0xDD 0xDA 0xD3 0xD4
0x69 0x6E 0x67 0x60 0x75 0x72 0x7B 0x7C 0x51 0x56 0x5F 0x58 0x4D 0x4A 0x43 0x44
0x19 0x1E 0x17 0x10 0x05 0x02 0x0B 0x0C 0x21 0x26 0x2F 0x28 0x3D 0x3A 0x33 0x34
0x4E 0x49 0x40 0x47 0x52 0x55 0x5C 0x5B 0x76 0x71 0x78 0x7F 0x6A 0x6D 0x64 0x63
0x3E 0x39 0x30 0x37 0x22 0x25 0x2C 0x2B 0x06 0x01 0x08 0x0F 0x1A 0x1D 0x14 0x13
0xAE 0xA9 0xA0 0xA7 0xB2 0xB5 0xBC 0xBB 0x96 0x91 0x98 0x9F 0x8A 0x8D 0x84 0x83
0xDE 0xD9 0xD0 0xD7 0xC2 0xC5 0xCC 0xCB 0xE6 0xE1 0xE8 0xEF 0xFA 0xFD 0xF4 0xF3 */

static byte Compute_CRC8(byte bytes[8])
{
    byte crc = 0xFF;
    int i = 1;
    for (i=1;i<sizeof(bytes);i++)    // Count start from 1 so that byte 0 is ignored in the CRC (byte 0 IS the CRC value)
    {
        /* XOR-in next input byte */
        byte data = (byte)(bytes[i] ^ crc);     // ^ is bitwise XOR
        /* get current CRC value = remainder */
        crc = (byte)(crc8_data[data]);
    }

    return crc;
}

/*static byte CRC_calcx(byte* msg) {    // Original CRC code from previous versios
	byte data = 0xFF;

	data = crc8_data[data ^ msg->bytes[1]];
	data = crc8_data[data ^ msg->bytes[2]];
	data = crc8_data[data ^ msg->bytes[3]];
	data = crc8_data[data ^ msg->bytes[4]];
	data = crc8_data[data ^ msg->bytes[5]];
	data = crc8_data[data ^ msg->bytes[6]];
	data = crc8_data[data ^ msg->bytes[7]];
	
	return(data);
} */

// END FILE

